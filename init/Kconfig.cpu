## init/Kconfig.cpu
```kconfig
choice
	prompt "ZenSched CPU Scheduler Choice"
	default CPU_CFS
	help
	  Here you can choose the CPU scheduler to be compiled with the kernel.

	  If you do not know what you are doing, choose "Completely Fair Scheduler".

config CPU_CFS
	bool "Completely Fair Scheduler (CFS)"
	help
	  The "Completely Fair Scheduler" (CFS), developed by Ingo Molnar,
	  is the CPU scheduler used in the default vanilla kernel.

config CPU_BFS
	bool "Brainfuck Scheduler (BFS)"
	help
	  The "Brainfuck Scheduler" (BFS) is a new CPU scheduler developed
	  by Con Kolivas. It is designed for ultra low latency and excellent
	  desktop performance.

	  It is not recommened for 4096 CPUs.

endchoice

config CPU_BFS_AUTOISO
        bool "Auto SCHED_ISO for X"
        depends on CPU_BFS
        help
          Enable this to automatically enable SCHED_ISO for X

config CFS_BOOST
	bool "Boost X Privilege"
	default y
	depends on CPU_CFS
	help
	  This option instructs the kernel to guarantee more CPU time to
	  X than to other tasks, which is sueful if you want to have a
	  faster desktop even under high system load.

	  This option works by automatically boosting X's priority via
	  renicing it to -10. NOTE: CFS does not suffer from
	  "overscheduling" problems when X is reniced to -10, so if this
	  is a predominantly desktop box it makes sense to select this option

	  Say Y here if you are building a kernel for a desktop system.
	  Say N here if you want X to be treated as a normal task.
```
